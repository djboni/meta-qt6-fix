## conf/layer.conf
```bitbake
BBPATH .= ":${LAYERDIR}"
BBFILES += "${LAYERDIR}/recipes-*/*/*.bb \
            ${LAYERDIR}/recipes-*/*/*.bbappend"
BBFILE_COLLECTIONS += "metaqt6fix"
BBFILE_PATTERN_metaqt6fix = "^${LAYERDIR}/"
BBFILE_PRIORITY_metaqt6fix = "5"
LAYERVERSION_metaqt6fix = "4"
LAYERSERIES_COMPAT_metaqt6fix = "kirkstone"
```
